## boot/boot.its
```
/*
 * FIT image 描述 —— 给原厂 uboot 吃的那种
 *
 * 为什么是 FIT 而不是 extlinux/Image:
 *   原厂 uboot (U-Boot 2017.09, OneCloudFirmware 定制) 是 Android 风格的，
 *   它从 GPT 里名为 boot 的分区找 FIT：
 *       [lzj-d][fit_get_blob-158]: part_name = boot
 *       FIT: No fit blob / FIT: No fit image
 *   它不认 extlinux.conf，也不认 /boot/dtb/rockchip/*.dtb。
 *
 * 地址用的是 Rockchip 标准 load 地址（include/configs/rockchip-common.h）：
 *   kernel_addr_r  = 0x02080000
 *   fdt_addr_r     = 0x0a100000
 *   ramdisk_addr_r = 0x0a200000
 *
 * 没有 ramdisk 节点：BSP 内核 defconfig 里 EXT4_FS=y / MMC_SDHCI_OF_DWCMSHC=y /
 * MMC_DW=y 全是内建，直接 root=/dev/mmcblk2p14 就能挂，不需要 initramfs。
 */
/dts-v1/;

/ {
	description = "GM RK3566 Speaker (Rockchip BSP 6.1)";
	#address-cells = <1>;

	images {
		kernel {
			description = "Linux BSP 6.1 kernel";
			data = /incbin/("Image.gz");
			type = "kernel";
			arch = "arm64";
			os = "linux";
			compression = "gzip";
			load = <0x02080000>;
			entry = <0x02080000>;
			hash-1 {
				algo = "sha256";
			};
		};

		fdt {
			description = "rk3566-guomeiyun.dtb";
			data = /incbin/("board.dtb");
			type = "flat_dt";
			arch = "arm64";
			compression = "none";
			load = <0x0a100000>;
			hash-1 {
				algo = "sha256";
			};
		};
	};

	configurations {
		default = "conf";
		conf {
			description = "rk3566-guomeiyun";
			kernel = "kernel";
			fdt = "fdt";
		};
	};
};
```
